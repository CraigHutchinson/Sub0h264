## test_apps/esp_shootout/sdkconfig.defaults
```kconfig
# test_apps/esp_shootout/sdkconfig.defaults
# ESP32-P4 config for Sub0h264 vs libavc shootout.

# ── Chip / flash ──────────────────────────────────────────────────────────────
CONFIG_IDF_TARGET="esp32p4"
CONFIG_ESPTOOLPY_FLASHSIZE_16MB=y
CONFIG_ESPTOOLPY_FLASHSIZE="16MB"

# ── Chip revision ─────────────────────────────────────────────────────────────
CONFIG_ESP32P4_SELECTS_REV_LESS_V3=y
CONFIG_ESP32P4_REV_MIN_100=y
CONFIG_PARTITION_TABLE_CUSTOM=y
CONFIG_PARTITION_TABLE_CUSTOM_FILENAME="partitions.csv"
CONFIG_ESPTOOLPY_FLASHFREQ_80M=y

# ── PSRAM (OPI, 200 MHz) — libavc needs PSRAM for output buffers ─────────────
CONFIG_SPIRAM=y
CONFIG_SPIRAM_SPEED_200M=y

# ── C++ ─────────────────────────────────────────────────────────────────────────
CONFIG_COMPILER_CXX_EXCEPTIONS=y
CONFIG_COMPILER_CXX_EXCEPTIONS_EMG_POOL_SIZE=1024
CONFIG_COMPILER_CXX_RTTI=n

# ── CPU frequency — 360 MHz ────────────────────────────────────────────────────
CONFIG_ESP_DEFAULT_CPU_FREQ_MHZ_360=y

# ── Compiler optimisation ──────────────────────────────────────────────────────
CONFIG_COMPILER_OPTIMIZATION_PERF=y

# ── Watchdog: very generous for full shootout (libavc can be slow) ─────────────
CONFIG_ESP_TASK_WDT_TIMEOUT_S=120
CONFIG_ESP_TASK_WDT_PANIC=n
CONFIG_ESP_TASK_WDT_CHECK_IDLE_TASK_CPU0=n
CONFIG_ESP_TASK_WDT_CHECK_IDLE_TASK_CPU1=n

# ── Stack: large for both decoders ────────────────────────────────────────────
CONFIG_ESP_MAIN_TASK_STACK_SIZE=131072

# ── Log level ──────────────────────────────────────────────────────────────────
CONFIG_LOG_DEFAULT_LEVEL_INFO=y

# ── Disable Bluetooth ──────────────────────────────────────────────────────────
CONFIG_BT_ENABLED=n
```

## test_apps/hello_h264/sdkconfig.defaults
```kconfig
# test_apps/hello_h264/sdkconfig.defaults
# Minimal ESP32-P4 config for Sub0h264 hello-world.

# -- Chip / flash -------------------------------------------------------------
CONFIG_IDF_TARGET="esp32p4"
CONFIG_ESPTOOLPY_FLASHSIZE_16MB=y
CONFIG_ESPTOOLPY_FLASHSIZE="16MB"
CONFIG_ESPTOOLPY_FLASHFREQ_80M=y

# -- Chip revision — device is v1.3 (rev <3.0) --------------------------------
CONFIG_ESP32P4_SELECTS_REV_LESS_V3=y
CONFIG_ESP32P4_REV_MIN_100=y
CONFIG_PARTITION_TABLE_CUSTOM=y
CONFIG_PARTITION_TABLE_CUSTOM_FILENAME="partitions.csv"

# -- PSRAM (OPI, 200 MHz) -----------------------------------------------------
CONFIG_SPIRAM=y
CONFIG_SPIRAM_SPEED_200M=y

# -- C++ standard — IDF master defaults to C++23 (gnu++23) ---------------------

# -- C++ exceptions ------------------------------------------------------------
CONFIG_COMPILER_CXX_EXCEPTIONS=y
CONFIG_COMPILER_CXX_EXCEPTIONS_EMG_POOL_SIZE=1024

# -- RTTI disabled -------------------------------------------------------------
CONFIG_COMPILER_CXX_RTTI=n

# -- CPU frequency — 360 MHz (ESP32-P4 rev v1.3 maximum) ----------------------
CONFIG_ESP_DEFAULT_CPU_FREQ_MHZ_360=y

# -- Compiler optimisation -----------------------------------------------------
CONFIG_COMPILER_OPTIMIZATION_PERF=y

# -- Log level -----------------------------------------------------------------
CONFIG_LOG_DEFAULT_LEVEL_INFO=y

# -- Disable Bluetooth ---------------------------------------------------------
CONFIG_BT_ENABLED=n
```

## test_apps/unit_tests/sdkconfig.defaults
```kconfig
# test_apps/unit_tests/sdkconfig.defaults
# ESP32-P4 config for unit test runner.

# ── Chip / flash ──────────────────────────────────────────────────────────────
CONFIG_IDF_TARGET="esp32p4"
CONFIG_ESPTOOLPY_FLASHSIZE_16MB=y
CONFIG_ESPTOOLPY_FLASHSIZE="16MB"

# ── Chip revision — device is v1.3 (rev <3.0) ─────────────────────────────────
CONFIG_ESP32P4_SELECTS_REV_LESS_V3=y
CONFIG_ESP32P4_REV_MIN_100=y
CONFIG_PARTITION_TABLE_CUSTOM=y
CONFIG_PARTITION_TABLE_CUSTOM_FILENAME="partitions.csv"
CONFIG_ESPTOOLPY_FLASHFREQ_80M=y

# ── PSRAM (OPI, 200 MHz) ───────────────────────────────────────────────────────
CONFIG_SPIRAM=y
CONFIG_SPIRAM_SPEED_200M=y

# ── C++ ─────────────────────────────────────────────────────────────────────────
CONFIG_COMPILER_CXX_EXCEPTIONS=y
CONFIG_COMPILER_CXX_EXCEPTIONS_EMG_POOL_SIZE=1024
CONFIG_COMPILER_CXX_RTTI=n

# ── CPU frequency — 360 MHz ────────────────────────────────────────────────────
CONFIG_ESP_DEFAULT_CPU_FREQ_MHZ_360=y

# ── Compiler optimisation ──────────────────────────────────────────────────────
CONFIG_COMPILER_OPTIMIZATION_PERF=y

# ── Watchdog: generous timeout for decode tests ────────────────────────────────
CONFIG_ESP_TASK_WDT_TIMEOUT_S=120
# Disable panic on WDT: log warning instead of reboot during testing
CONFIG_ESP_TASK_WDT_PANIC=n

# ── Stack: larger main task stack for doctest + decoder ────────────────────────
# 64KB stack — sufficient with heap-allocated decoders (see coding-style.md)
CONFIG_ESP_MAIN_TASK_STACK_SIZE=65536

# ── Log level ──────────────────────────────────────────────────────────────────
CONFIG_LOG_DEFAULT_LEVEL_INFO=y

# ── Disable Bluetooth ──────────────────────────────────────────────────────────
CONFIG_BT_ENABLED=n
```
